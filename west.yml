## west.yml
```yaml
# Example your-application/west.yml, using manifest imports, with
# an NCS fork and a separate module
manifest:
  remotes:
    - name: ncs
      url-base: https://github.com/nrfconnect
      
  projects:
    - name: nrf
      remote: ncs
      repo-path: sdk-nrf
      revision: v1.4.1
      import: true
    # # Example for how to override a repository in the NCS with your own:
    # - name: mcuboot
    #   remote: your-remote
    #   revision: your-mcuboot-fork-SHA-or-branch
    # # Example for how to add a repository not in NCS:
    # - name: your-custom-library
    #   remote: your-remote
    #   revision: your-library-SHA-or-branch
  self:
    path: nrf_external_examples
```
